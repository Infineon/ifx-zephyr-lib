## zephyr/Kconfig
```kconfig
# TinyUSB stack integration for Zephyr
#
# Copyright (c) 2026 Infineon Technologies AG,
# or an affiliate of Infineon Technologies AG.
#
# SPDX-License-Identifier: Apache-2.0

# Hidden symbol set automatically when this module is present, used so other
# Kconfig/CMake logic can detect TinyUSB availability.
config ZEPHYR_TINYUSB_MODULE
	bool

menuconfig TINYUSB
	bool "TinyUSB USB stack"
	help
	  Build and link the TinyUSB stack. The application must provide a
	  tusb_config.h on the global include path (see TINYUSB_CONFIG_PATH)
	  and call tusb_init() / tud_task() / tuh_task() as appropriate.

if TINYUSB

config TINYUSB_CONFIG_PATH
	string "Directory containing the application tusb_config.h"
	default ""
	help
	  Absolute path of the directory that holds the application provided
	  tusb_config.h. It is added to the global include path so that the
	  TinyUSB sources can find it. Leave empty if the application already
	  exposes the header via zephyr_include_directories().

choice TINYUSB_PORT
	prompt "USB controller port driver"
	default TINYUSB_PORT_DWC2_IFX
	help
	  Select the device/host controller driver to compile for the target
	  SoC. This determines CFG_TUSB_MCU and the portable sources added to
	  the build.

config TINYUSB_PORT_DWC2_IFX
	bool "Synopsys DWC2 (Infineon PSE84 high-speed)"
	help
	  Synopsys DWC2 controller with the Infineon (DWC2_IFX) glue, as used
	  by the PSOC Edge E84 (PSE84) high-speed USB peripheral.

endchoice

if TINYUSB_PORT_DWC2_IFX

config TINYUSB_DWC2_IFX_IRQ_CONNECT
	bool "Connect the USBHS controller IRQ from devicetree"
	default n
	help
	  Connect the on-chip USBHS (DWC2) controller interrupt to TinyUSB's
	  tusb_int_handler() at boot, using the interrupt of the devicetree
	  node labelled 'usbhs'. This lets an application drive the TinyUSB
	  stack without a hw/bsp board layer wiring the IRQ.

	  Mutually exclusive with a TinyUSB hw/bsp board layer that also
	  connects the interrupt.
	  Leave disabled for samples that still use the hw/bsp board layer;
	  enable it for BSP-free samples that call tusb_init() directly.

config TINYUSB_DWC2_IFX_INIT_PRIORITY
	int "TinyUSB DWC2 IFX init priority"
	default 90
	depends on TINYUSB_DWC2_IFX_IRQ_CONNECT
	help
	  SYS_INIT priority in the POST_KERNEL level at which the USBHS
	  interrupt is connected and enabled. Must run before the application
	  calls tusb_init().

endif # TINYUSB_PORT_DWC2_IFX

config TINYUSB_CFG_TUSB_MCU
	string
	default "OPT_MCU_PSE84" if TINYUSB_PORT_DWC2_IFX
	help
	  Value passed to the TinyUSB CFG_TUSB_MCU define. Derived from the
	  selected controller port; not intended to be set directly.

config TINYUSB_LOG_LEVEL
	int "TinyUSB debug log level (CFG_TUSB_DEBUG)"
	range 0 4
	default 0
	help
	  Verbosity of the TinyUSB internal logging. 0 disables logging; higher
	  values are progressively more verbose. Level 4 disables inlining.

endif # TINYUSB
```

## zephyr/dts/bindings/tflite,micro-npu.yaml
```yaml
# SPDX-License-Identifier: Apache-2.0
# Copyright (c) 2024 Infineon Technologies AG

description: TensorFlow Lite Micro NPU Configuration

compatible: "tflite,micro-npu"

properties:
  acceleration-type:
    type: string
    enum:
      - "none"
      - "ethos-u55"  
      - "nnlite"
      - "cmsis-nn"
    default: "none"
    description: |
      Hardware acceleration type for TensorFlow Lite Micro inference.
      - none: Software-only inference
      - ethos-u55: ARM Ethos-U55 NPU acceleration  
      - nnlite: Infineon NNLite NPU acceleration
      - cmsis-nn: ARM CMSIS-NN optimization

  model-cache-size:
    type: int
    default: 8192
    description: |
      Size of model cache in bytes for acceleration hardware.

  arena-size:  
    type: int
    default: 8192
    description: |
      TensorFlow Lite Micro arena size in bytes.

  quantization-support:
    type: string-array
    enum:
      - "int8"
      - "int16" 
      - "float32"
    default: ["float32"]
    description: |
      Supported quantization types for this accelerator.

  memory-region:
    type: phandle
    description: |
      Memory region for NPU operations and model storage.

  cache-management:
    type: string
    enum:
      - "none"
      - "automatic"
      - "conditional"
    default: "automatic"
    description: |
      Cache management strategy for NPU operations.
      - none: No cache management
      - automatic: Hardware handles cache coherency
      - conditional: Software manages cache based on data types

  performance-monitoring:
    type: boolean
    description: |
      Enable performance monitoring for NPU operations.

  max-models:
    type: int
    default: 1
    description: |
      Maximum number of concurrent models supported.

  interrupts:
    description: |
      Interrupt configuration for NPU completion signals.

  interrupt-names:
    description: |
      Names for NPU interrupts (inference-complete, error, etc.).

  power-domain:
    type: phandle  
    description: |
      Power domain for NPU hardware.

  clock-frequency:
    type: int
    description: |
      NPU operating frequency in Hz.

  voltage-levels:
    type: array
    description: |
      Supported voltage levels for NPU operation.

  thermal-zone:
    type: phandle
    description: |
      Thermal zone for NPU temperature monitoring.

child-binding:
  description: Model-specific configuration

  properties:
    model-name:
      type: string
      description: Identifier for the model

    model-size:
      type: int  
      description: Size of the model in bytes

    input-tensors:
      type: int
      default: 1
      description: Number of input tensors

    output-tensors:
      type: int
      default: 1
      description: Number of output tensors

    quantization:
      type: string
      enum:
        - "int8"
        - "int16"
        - "float32"
      default: "float32"
      description: Model quantization type

    acceleration-required:
      type: boolean
      description: Whether this model requires hardware acceleration

    memory-footprint:
      type: int
      description: Expected memory usage in bytes during inference
```
